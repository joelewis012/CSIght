## esp32/main/Kconfig.projbuild
```kconfig
menu "CSIght Mesh Configuration"

    choice CSIGHT_ROLE
        prompt "Node role"
        default CSIGHT_ROLE_PRIMARY
        help
            Primary: wired to a Flipper Zero via UART, runs the full CSIght
            feature set (radar, waterfall, vitals, web UI) and aggregates
            readings from any secondary nodes on the network.

            Secondary: standalone unit with no Flipper attached. Detects
            motion locally and broadcasts readings to the primary over
            ESP-NOW. All secondary units use the same firmware image —
            v2.1 auto-discovery assigns each one an ID based on its unique
            factory MAC address, no manual per-unit configuration needed.

        config CSIGHT_ROLE_PRIMARY
            bool "Primary (wired to Flipper)"

        config CSIGHT_ROLE_SECONDARY
            bool "Secondary (standalone, auto-discovered)"
    endchoice

endmenu
```

## esp32/sdkconfig.defaults
```kconfig
# CSIght ESP32 sdkconfig defaults
# Safe settings — do NOT modify bootloader or partition table entries

# WiFi
CONFIG_ESP_WIFI_STATIC_RX_BUFFER_NUM=10
CONFIG_ESP_WIFI_DYNAMIC_RX_BUFFER_NUM=32
CONFIG_ESP_WIFI_CSI_ENABLED=y
CONFIG_ESP_WIFI_AMPDU_RX_ENABLED=y

# UART
CONFIG_ESP_CONSOLE_UART_DEFAULT=y
CONFIG_ESP_CONSOLE_UART_NUM=0

# FreeRTOS
CONFIG_FREERTOS_HZ=1000

# Compiler — keep strict
CONFIG_COMPILER_OPTIMIZATION_SIZE=y

# Partition table — two OTA slots + otadata, enables wireless firmware
# updates on the primary via the web dashboard (v3.1+).
#
# IMPORTANT: this changes the flash layout. Boards already flashed with an
# older CSIght build (single-app partition table) MUST be fully re-flashed
# once via USB/esptool or the Flipper's Flash Firmware feature before OTA
# will work — you cannot OTA your way onto a new partition table, since the
# bootloader itself needs the new partition map. After that one-time
# re-flash, OTA updates work normally from then on.
CONFIG_PARTITION_TABLE_TWO_OTA=y

# Flash size — the two-OTA partition table needs more than the 2MB implicit
# default. 4MB is the flash size on the overwhelming majority of ESP32 dev
# boards; if you're on a genuinely smaller/older board, lower this and note
# that OTA (which needs two full app copies) may not fit.
CONFIG_ESPTOOLPY_FLASHSIZE_4MB=y
CONFIG_ESPTOOLPY_FLASHSIZE="4MB"

# NVS
CONFIG_NVS_ENCRYPTION=n
```
